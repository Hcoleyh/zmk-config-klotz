/*
 * Copyright (c) 2022 GEIST
 *
 * SPDX-License-Identifier: MIT
 */

#include "klotz.dtsi"

&kscan0 {
	col-gpios
		= <&pro_micro 18 GPIO_ACTIVE_HIGH | GPIO_PULL_DOWN>
		, <&pro_micro 15 GPIO_ACTIVE_HIGH | GPIO_PULL_DOWN>
		, <&pro_micro 14 GPIO_ACTIVE_HIGH | GPIO_PULL_DOWN>
		, <&pro_micro 16 GPIO_ACTIVE_HIGH | GPIO_PULL_DOWN>
		, <&pro_micro 10 GPIO_ACTIVE_HIGH | GPIO_PULL_DOWN>
		;
};

&left_encoder {
	status = "okay";
};